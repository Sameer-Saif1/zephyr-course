## CMakeLists.txt
```
cmake_minimum_required(VERSION 3.20.0)

list(APPEND EXTRA_DTC_OVERLAY_FILE ${CMAKE_CURRENT_SOURCE_DIR}/app.overlay)

find_package(Zephyr REQUIRED)
project(my_zephyr_app)

target_sources(app PRIVATE src/main.cpp)
target_sources(app PRIVATE src/our_driver.c)
target_sources(app PRIVATE src/sensor_shell.c)
```

## Kconfig
```
menuconfig LED_SUBSYSTEM
	bool "LED Subsystem"
	default y

if LED_SUBSYSTEM

choice
	prompt "LED blink sleep time"
	default BLINK_SLEEP_1000MS

config BLINK_SLEEP_250MS
	bool "Fast (250ms)"

config BLINK_SLEEP_500MS
	bool "Medium-fast (500ms)"

config BLINK_SLEEP_1000MS
	bool "Medium (1s)"

config BLINK_SLEEP_2000MS
	bool "Slow (2s)"

endchoice

config BLINK_SLEEP_TIME_MS
	int
	default 250 if BLINK_SLEEP_250MS
	default 500 if BLINK_SLEEP_500MS
	default 1000 if BLINK_SLEEP_1000MS
	default 2000 if BLINK_SLEEP_2000MS
	default 1000

menuconfig LED_ADVANCED
	bool "Advanced LED settings"
	default n

if LED_ADVANCED

config LED_BRIGHTNESS
	int "LED brightness (0-100)"
	range 0 100
	default 100

config LED_FADE_DURATION_MS
	int "LED fade duration (ms)"
	range 0 5000
	default 500

menu "Expert settings"
	visible if LED_ADVANCED

config LED_DEBUG
	bool "Enable LED debugging"
	default n

config LED_CUSTOM_PATTERN
	bool "Custom blink pattern"
	default n

endmenu

endif # LED_ADVANCED

endif # LED_SUBSYSTEM

config APP_HEARTBEAT_PERIOD_MS
	int "Heartbeat LED period (ms)"
	default 500
	range 100 2000

source "Kconfig.zephyr"
```

## prj.conf
```kconfig
CONFIG_GPIO=y
CONFIG_SENSOR=y
CONFIG_SHELL=y
```

## app.overlay
```dts
/ {
	aliases {
		app-led = &myled;
	};

	my_sensor: my_sensor {
		compatible = "our,driver";
		gpios = <&gpio0 2 GPIO_ACTIVE_HIGH>;
		status = "okay";
	};
};
```

## boards/esp32_devkitc_procpu.overlay
```dts
/ {
	aliases {
		led0 = &myled;
	};

	leds {
		compatible = "gpio-leds";
		myled: led_0 {
			gpios = <&gpio0 2 GPIO_ACTIVE_HIGH>;
		};
	};
};
```

## dts/bindings/sensor/our,driver.yaml
```yaml
description: Our custom LED-based sensor driver
compatible: "our,driver"

properties:
  gpios:
    type: phandle-array
    required: true
    description: GPIO driving the LED used as the "sensor"
```

## src/main.cpp
```c
#include <zephyr/kernel.h>
#include <zephyr/drivers/gpio.h>
#include <zephyr/drivers/sensor.h>
#include "our_driver.h"

#define HEARTBEAT_NODE DT_ALIAS(app_led)
static const struct gpio_dt_spec heartbeat_led = GPIO_DT_SPEC_GET(HEARTBEAT_NODE, gpios);

int main(void)
{
	const struct device *sensor_dev = DEVICE_DT_GET_ANY(our_driver);

	if (sensor_dev && device_is_ready(sensor_dev)) {
		sensor_sample_fetch(sensor_dev);
		struct sensor_value val;
		sensor_channel_get(sensor_dev, SENSOR_CHAN_ALL, &val);
		printk("Sensor reported state: %d\n", val.val1);
		our_driver_set_level(sensor_dev, 42);
		int32_t lvl = 0;
		our_driver_get_level(sensor_dev, &lvl);
		printk("Level is now: %d\n", (int)lvl);

	}

	if (!gpio_is_ready_dt(&heartbeat_led)) {
		return 0;
	}
	gpio_pin_configure_dt(&heartbeat_led, GPIO_OUTPUT_ACTIVE);

		while (1) {
		gpio_pin_toggle_dt(&heartbeat_led);
		k_msleep(CONFIG_APP_HEARTBEAT_PERIOD_MS);
	}
}
```

## src/our_driver.c
```c
#define DT_DRV_COMPAT our_driver

#include <stdbool.h>
#include <stdint.h>
#include <zephyr/drivers/gpio.h>
#include <zephyr/drivers/sensor.h>
#include <zephyr/kernel.h>
#include <zephyr/logging/log.h>
#include "our_driver.h"

LOG_MODULE_REGISTER(our_driver, CONFIG_SENSOR_LOG_LEVEL);

struct our_driver_config {
	struct gpio_dt_spec led;
};

struct our_driver_data {
	bool led_state;
	int32_t level;
};

int our_driver_set_level(const struct device *dev, int32_t level)
{
	struct our_driver_data *data = dev->data;

	if (level < 0 || level > 100) {
		return -EINVAL;
	}

	data->level = level;
	LOG_INF("level set to %d", level);
	return 0;
}

int our_driver_get_level(const struct device *dev, int32_t *level)
{
	struct our_driver_data *data = dev->data;

	*level = data->level;
	return 0;
}

static int our_driver_sample_fetch(const struct device *dev, enum sensor_channel chan)
{
	const struct our_driver_config *cfg = dev->config;
	struct our_driver_data *data = dev->data;

	ARG_UNUSED(chan);

	int ret = gpio_pin_set_dt(&cfg->led, 1);
	if (ret < 0) {
		return ret;
	}

	data->led_state = true;
	return 0;
}

static int our_driver_channel_get(const struct device *dev, enum sensor_channel chan,
				   struct sensor_value *val)
{
	const struct our_driver_config *cfg = dev->config;
	struct our_driver_data *data = dev->data;

	ARG_UNUSED(chan);

	val->val1 = data->led_state ? 1 : 0;
	val->val2 = 0;

	int ret = gpio_pin_set_dt(&cfg->led, 0);
	if (ret < 0) {
		return ret;
	}

	data->led_state = false;
	return 0;
}

static DEVICE_API(sensor, our_driver_api) = {
	.sample_fetch = our_driver_sample_fetch,
	.channel_get = our_driver_channel_get,
};

static int our_driver_init(const struct device *dev)
{
	const struct our_driver_config *cfg = dev->config;

	if (!gpio_is_ready_dt(&cfg->led)) {
		return -ENODEV;
	}

	return gpio_pin_configure_dt(&cfg->led, GPIO_OUTPUT_INACTIVE);
}

#define OUR_DRIVER_DEFINE(inst)                                                    \
	static struct our_driver_data our_driver_data_##inst;                      \
	static const struct our_driver_config our_driver_config_##inst = {         \
		.led = GPIO_DT_SPEC_INST_GET(inst, gpios),                         \
	};                                                                           \
	DEVICE_DT_INST_DEFINE(inst, our_driver_init, NULL,                          \
			      &our_driver_data_##inst, &our_driver_config_##inst,  \
			      POST_KERNEL, CONFIG_SENSOR_INIT_PRIORITY,            \
			      &our_driver_api)

DT_INST_FOREACH_STATUS_OKAY(OUR_DRIVER_DEFINE)
```

## src/our_driver.h
```c
#ifndef OUR_DRIVER_H_
#define OUR_DRIVER_H_

#include <zephyr/device.h>
#include <stdint.h>

#ifdef __cplusplus
extern "C" {
#endif

int our_driver_set_level(const struct device *dev, int32_t level);
int our_driver_get_level(const struct device *dev, int32_t *level);

#ifdef __cplusplus
}
#endif

#endif
```

## src/sensor_shell.c
```c
#include <stdlib.h>
#include <zephyr/shell/shell.h>
#include <zephyr/drivers/sensor.h>
#include <zephyr/device.h>
#include "our_driver.h"

static const struct device *get_sensor_dev(void)
{
	return DEVICE_DT_GET_ANY(our_driver);
}

static int cmd_sensor_fetch(const struct shell *sh, size_t argc, char **argv)
{
	ARG_UNUSED(argc);
	ARG_UNUSED(argv);

	const struct device *dev = get_sensor_dev();

	if (!dev || !device_is_ready(dev)) {
		shell_error(sh, "Sensor device not ready");
		return -ENODEV;
	}

	int ret = sensor_sample_fetch(dev);

	if (ret < 0) {
		shell_error(sh, "sample_fetch failed: %d", ret);
		return ret;
	}

	shell_print(sh, "Sample fetched (LED ON)");
	return 0;
}

static int cmd_sensor_read(const struct shell *sh, size_t argc, char **argv)
{
	ARG_UNUSED(argc);
	ARG_UNUSED(argv);

	const struct device *dev = get_sensor_dev();

	if (!dev || !device_is_ready(dev)) {
		shell_error(sh, "Sensor device not ready");
		return -ENODEV;
	}

	struct sensor_value val;
	int ret = sensor_channel_get(dev, SENSOR_CHAN_ALL, &val);

	if (ret < 0) {
		shell_error(sh, "channel_get failed: %d", ret);
		return ret;
	}

	shell_print(sh, "Channel value: %d (LED now OFF)", val.val1);
	return 0;
}

static int cmd_sensor_info(const struct shell *sh, size_t argc, char **argv)
{
	ARG_UNUSED(argc);
	ARG_UNUSED(argv);

	const struct device *dev = get_sensor_dev();

	if (!dev) {
		shell_error(sh, "Sensor device not found");
		return -ENODEV;
	}

	shell_print(sh, "Device: %s", dev->name);
	shell_print(sh, "Ready: %s", device_is_ready(dev) ? "yes" : "no");
	return 0;
}

static int cmd_sensor_set(const struct shell *sh, size_t argc, char **argv)
{
	ARG_UNUSED(argc);

	const struct device *dev = get_sensor_dev();

	if (!dev || !device_is_ready(dev)) {
		shell_error(sh, "Sensor device not ready");
		return -ENODEV;
	}

	char *endptr;
	long value = strtol(argv[1], &endptr, 10);

	if (*endptr != '\0' || value < 0 || value > 100) {
		shell_error(sh, "Invalid value '%s': must be an integer 0-100", argv[1]);
		return -EINVAL;
	}

	int ret = our_driver_set_level(dev, (int32_t)value);

	if (ret < 0) {
		shell_error(sh, "Failed to set level: %d", ret);
		return ret;
	}

	shell_print(sh, "Level set to %ld", value);
	return 0;
}

SHELL_STATIC_SUBCMD_SET_CREATE(sub_sensor,
	SHELL_CMD(fetch, NULL, "Fetch a sample (turns LED ON)", cmd_sensor_fetch),
	SHELL_CMD(read, NULL, "Read last channel value (turns LED OFF)", cmd_sensor_read),
	SHELL_CMD(info, NULL, "Show device name and ready state", cmd_sensor_info),
	SHELL_CMD_ARG(set, NULL, "Set level: sensor set <0-100>", cmd_sensor_set, 2, 0),
	SHELL_SUBCMD_SET_END
);

SHELL_CMD_REGISTER(sensor, &sub_sensor, "Custom sensor driver commands", NULL);
```
